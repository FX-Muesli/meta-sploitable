## conf/layer.conf
```bitbake
# SPDX-FileCopyrightText: 2024 Felix Mues <felix.mues@tu-dortmund.de>
# SPDX-License-Identifier: MIT

# We have a conf and classes directory, add to BBPATH
BBPATH .= ":${LAYERDIR}"

# We have recipes-* directories, add to BBFILES
BBFILES += "${LAYERDIR}/recipes-*/*/*.bb \
            ${LAYERDIR}/recipes-*/*/*.bbappend"

BBFILE_COLLECTIONS += "sploitable"
BBFILE_PATTERN_sploitable = "^${LAYERDIR}/"
BBFILE_PRIORITY_sploitable = "5"
LAYERVERSION_sploitable = "1"
LAYERSERIES_COMPAT_sploitable = "langdale"

# See if this is allowed
DISTRO_FEATURES:append = " virtualization"
# selinux settings
DISTRO_FEATURES:append = " acl xattr pam selinux"
PREFERRED_PROVIDER_refpolicy ?= "refpolicy-mls"

# activate UART for raspberryPi
ENABLE_UART = "1"
```
